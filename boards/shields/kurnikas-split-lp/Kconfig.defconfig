## boards/shields/kurnikas-split-lp/Kconfig.defconfig
```kconfig
if SHIELD_KURNIKAS_SPLIT_LP_DONGLE || SHIELD_KURNIKAS_SPLIT_LP_LEFT_CENTRAL

# Name must be less than 16 characters long!
config ZMK_KEYBOARD_NAME
    default "KurnikasLP"

config ZMK_SPLIT_ROLE_CENTRAL
    default y

config ZMK_SPLIT
    default y

# Set this to ZMK_SPLIT_BLE_CENTRAL_PERIPHERALS + your desired number of BT profiles (default is 5)
config BT_MAX_CONN
    default 6
# Set this to the same number as BT_MAX_CONN
config BT_MAX_PAIRED
    default 6
endif


if SHIELD_KURNIKAS_SPLIT_LP_RIGHT || SHIELD_KURNIKAS_SPLIT_LP_LEFT_PERIPHERAL
config ZMK_SPLIT
    default y
endif

if SHIELD_KURNIKAS_SPLIT_LP_DONGLE
# Set this to the number of peripherals your dongle will have.
# For a unibody, this would be 1. If you have left and right halves, set it to 2, etc.
config ZMK_SPLIT_BLE_CENTRAL_PERIPHERALS
    default 2
config ZMK_USB
    default y
endif

if SHIELD_KURNIKAS_SPLIT_LP_LEFT_CENTRAL
# Set this to the number of peripherals your dongle will have.
# For a unibody, this would be 1. If you have left and right halves, set it to 2, etc.
config ZMK_SPLIT_BLE_CENTRAL_PERIPHERALS
    default 1
config ZMK_USB
    default y
endif
```

## boards/shields/kurnikas-split-lp/Kconfig.shield
```kconfig
config SHIELD_KURNIKAS_SPLIT_LP_LEFT_CENTRAL
    def_bool $(shields_list_contains,kurnikas-split-lp-left-central)

config SHIELD_KURNIKAS_SPLIT_LP_LEFT_PERIPHERAL
    def_bool $(shields_list_contains,kurnikas-split-lp-left-peripheral)

config SHIELD_KURNIKAS_SPLIT_LP_RIGHT
    def_bool $(shields_list_contains,kurnikas-split-lp-right)

config SHIELD_KURNIKAS_SPLIT_LP_DONGLE
    def_bool $(shields_list_contains,kurnikas-split-lp-dongle)
```
